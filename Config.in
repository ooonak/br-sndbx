## Config.in
```kconfig
source "$BR2_EXTERNAL_SNDBX_PATH/package/fluent-bit/Config.in"
source "$BR2_EXTERNAL_SNDBX_PATH/package/untitled1/Config.in"
```

## configs/sndbx_qemu_aarch64_virt_defconfig
```kconfig
BR2_aarch64=y
BR2_BINUTILS_VERSION_2_39_X=y
BR2_GCC_VERSION_12_X=y
BR2_TOOLCHAIN_BUILDROOT_CXX=y
BR2_PACKAGE_HOST_GDB=y
BR2_PACKAGE_HOST_GDB_TUI=y
BR2_GDB_VERSION_12=y
BR2_DL_DIR="$(HOME)/data/dl"
BR2_CCACHE=y
BR2_CCACHE_DIR="$(HOME)/data/buildroot-ccache"
BR2_INIT_SYSTEMD=y
BR2_SYSTEM_DHCP="eth0"
BR2_SYSTEM_DEFAULT_PATH="/bin:/sbin:/usr/bin:/usr/sbin"
BR2_ROOTFS_POST_IMAGE_SCRIPT="board/qemu/post-image.sh"
BR2_ROOTFS_POST_SCRIPT_ARGS="$(BR2_DEFCONFIG)"
BR2_LINUX_KERNEL=y
BR2_LINUX_KERNEL_CUSTOM_VERSION=y
BR2_LINUX_KERNEL_CUSTOM_VERSION_VALUE="6.1.8"
BR2_LINUX_KERNEL_USE_CUSTOM_CONFIG=y
BR2_LINUX_KERNEL_CUSTOM_CONFIG_FILE="board/qemu/aarch64-virt/linux.config"
BR2_LINUX_KERNEL_NEEDS_HOST_OPENSSL=y
BR2_PACKAGE_CA_CERTIFICATES=y
BR2_PACKAGE_LIBSODIUM=y
# BR2_PACKAGE_LIBSODIUM_FULL is not set
BR2_PACKAGE_SPDLOG=y
BR2_PACKAGE_GTEST=y
BR2_PACKAGE_GTEST_GMOCK=y
BR2_PACKAGE_MOSQUITTO=y
# BR2_PACKAGE_MOSQUITTO_BROKER is not set
BR2_PACKAGE_OPENSSH=y
BR2_TARGET_ROOTFS_EXT2=y
BR2_TARGET_ROOTFS_EXT2_4=y
# BR2_TARGET_ROOTFS_TAR is not set
BR2_PACKAGE_HOST_QEMU=y
BR2_PACKAGE_HOST_QEMU_SYSTEM_MODE=y
BR2_PACKAGE_FLUENT_BIT=y
```

## package/fluent-bit/Config.in
```kconfig
config BR2_PACKAGE_FLUENT_BIT
    bool "fluent-bit"
    depends on BR2_INSTALL_LIBSTDCPP
    depends on BR2_PACKAGE_OPENSSL
    depends on BR2_TOOLCHAIN_USES_GLIBC
    depends on !BR2_STATIC_LIBS
    help
      Fluent Bit is a Fast and Lightweight Logs and Metrics Processor and
      Forwarder for Linux, OSX, Windows and BSD family operating systems.
      It has been made with a strong focus on performance to allow the
      collection of events from different sources without complexity.

      https://fluentbit.io/

comment "A toolchain with C++ dynamic library is needed."
```
